## Config.in
```kconfig
source "$BR2_EXTERNAL_ROCKOS_PATH/package/rockos-browser/Config.in"
source "$BR2_EXTERNAL_ROCKOS_PATH/package/wvkbd/Config.in"
source "$BR2_EXTERNAL_ROCKOS_PATH/package/kbd-toggle/Config.in"
```

## config/rockos-rpi5_defconfig
```kconfig
BR2_aarch64=y
BR2_cortex_a76=y
BR2_PACKAGE_HOST_LINUX_HEADERS_CUSTOM_6_12=y
BR2_TOOLCHAIN_BUILDROOT_CXX=y
BR2_CCACHE=y
BR2_GLOBAL_PATCH_DIR="../patches"
BR2_DOWNLOAD_FORCE_CHECK_HASHES=y
BR2_TARGET_GENERIC_ISSUE="RockOS"
BR2_ROOTFS_DEVICE_CREATION_DYNAMIC_EUDEV=y
# BR2_TARGET_GENERIC_GETTY is not set
BR2_SYSTEM_DHCP="eth0"
BR2_ROOTFS_OVERLAY="../rockos-overlay"
BR2_ROOTFS_POST_BUILD_SCRIPT="../scripts/post-build.sh"
BR2_ROOTFS_POST_IMAGE_SCRIPT="../board/rockos/rpi5/post-image.sh"
BR2_LINUX_KERNEL=y
BR2_LINUX_KERNEL_CUSTOM_TARBALL=y
BR2_LINUX_KERNEL_CUSTOM_TARBALL_LOCATION="$(call github,raspberrypi,linux,21b410140c47ffab5668399f6f143c7d7b935c8b)/linux-21b410140c47ffab5668399f6f143c7d7b935c8b.tar.gz"
BR2_LINUX_KERNEL_DEFCONFIG="bcm2712"
BR2_LINUX_KERNEL_CONFIG_FRAGMENT_FILES="../board/rockos/rpi5/linux-rockos-rpi5.fragment"
BR2_LINUX_KERNEL_DTS_SUPPORT=y
BR2_LINUX_KERNEL_INTREE_DTS_NAME="broadcom/bcm2712-rpi-5-b"
BR2_LINUX_KERNEL_NEEDS_HOST_OPENSSL=y
BR2_PACKAGE_BUSYBOX_SHOW_OTHERS=y
BR2_PACKAGE_XZ=y
BR2_PACKAGE_KMOD=y
BR2_PACKAGE_KMOD_TOOLS=y
BR2_PACKAGE_RPI_FIRMWARE=y
BR2_PACKAGE_RPI_FIRMWARE_CONFIG_FILE="../board/rockos/rpi5/config.txt"
BR2_PACKAGE_RPI_FIRMWARE_CMDLINE_FILE="../board/rockos/rpi5/cmdline.txt"
BR2_PACKAGE_RPI_FIRMWARE_INSTALL_DTB_OVERLAYS=y
BR2_PACKAGE_DEJAVU=y
BR2_PACKAGE_MESA3D=y
BR2_PACKAGE_MESA3D_GALLIUM_DRIVER_V3D=y
BR2_PACKAGE_MESA3D_GALLIUM_DRIVER_VC4=y
BR2_PACKAGE_MESA3D_OPENGL_ES=y
BR2_PACKAGE_QT5=y
BR2_PACKAGE_QT5WAYLAND=y
BR2_PACKAGE_QT5WEBENGINE=y
BR2_PACKAGE_WESTON=y
# BR2_PACKAGE_WESTON_SHELL_DESKTOP is not set
# BR2_PACKAGE_WESTON_SHELL_FULLSCREEN is not set
# BR2_PACKAGE_WESTON_SHELL_IVI is not set
# BR2_PACKAGE_WESTON_SCREENSHARE is not set
# BR2_PACKAGE_EUDEV_ENABLE_HWDB is not set
# BR2_PACKAGE_HWDATA_PCI_IDS is not set
# BR2_PACKAGE_HWDATA_USB_IDS is not set
BR2_PACKAGE_LIBGCRYPT=y
BR2_PACKAGE_LIBEPOXY=y
BR2_PACKAGE_XORG7=y
BR2_PACKAGE_XLIB_LIBX11=y
BR2_PACKAGE_LIBSOUP3=y
BR2_PACKAGE_LIBTASN1=y
BR2_TARGET_ROOTFS_EXT2=y
BR2_TARGET_ROOTFS_EXT2_SIZE="512M"
# BR2_TARGET_ROOTFS_TAR is not set
BR2_PACKAGE_HOST_DOSFSTOOLS=y
BR2_PACKAGE_HOST_GENIMAGE=y
BR2_PACKAGE_HOST_MTOOLS=y
```

## config/rockos_defconfig
```kconfig
BR2_x86_64=y
BR2_PACKAGE_HOST_LINUX_HEADERS_CUSTOM_6_18=y
BR2_TOOLCHAIN_BUILDROOT_CXX=y
BR2_GLOBAL_PATCH_DIR="board/qemu/patches"
BR2_DOWNLOAD_FORCE_CHECK_HASHES=y
BR2_TARGET_GENERIC_ISSUE="RockOS"
BR2_ROOTFS_DEVICE_CREATION_DYNAMIC_EUDEV=y
# BR2_TARGET_GENERIC_GETTY is not set
BR2_SYSTEM_DHCP="eth0"
BR2_ROOTFS_OVERLAY="../rockos-overlay"
BR2_ROOTFS_POST_BUILD_SCRIPT="../scripts/post-build.sh"
BR2_ROOTFS_POST_IMAGE_SCRIPT="board/qemu/post-image.sh support/scripts/genimage.sh"
BR2_ROOTFS_POST_SCRIPT_ARGS="$(BR2_DEFCONFIG)"
BR2_ROOTFS_POST_IMAGE_SCRIPT_ARGS="-c board/pc/genimage-bios.cfg"
BR2_LINUX_KERNEL=y
BR2_LINUX_KERNEL_CUSTOM_VERSION=y
BR2_LINUX_KERNEL_CUSTOM_VERSION_VALUE="6.18.7"
BR2_LINUX_KERNEL_USE_CUSTOM_CONFIG=y
BR2_LINUX_KERNEL_CUSTOM_CONFIG_FILE="../config/linux-rockos.config"
BR2_LINUX_KERNEL_NEEDS_HOST_LIBELF=y
BR2_PACKAGE_DEJAVU=y
BR2_PACKAGE_MESA3D=y
BR2_PACKAGE_MESA3D_LEGACY_BIND_WAYLAND_DISPLAY=y
BR2_PACKAGE_MESA3D_GALLIUM_DRIVER_SOFTPIPE=y
BR2_PACKAGE_MESA3D_GALLIUM_DRIVER_VIRGL=y
BR2_PACKAGE_MESA3D_OPENGL_ES=y
BR2_PACKAGE_QT5=y
BR2_PACKAGE_QT5WAYLAND=y
BR2_PACKAGE_QT5WEBENGINE=y
BR2_PACKAGE_WESTON=y
# BR2_PACKAGE_WESTON_SHELL_DESKTOP is not set
# BR2_PACKAGE_WESTON_SHELL_FULLSCREEN is not set
# BR2_PACKAGE_WESTON_SHELL_IVI is not set
# BR2_PACKAGE_WESTON_SCREENSHARE is not set
BR2_PACKAGE_XORG7=y
# BR2_PACKAGE_EUDEV_ENABLE_HWDB is not set
# BR2_PACKAGE_HWDATA_PCI_IDS is not set
# BR2_PACKAGE_HWDATA_USB_IDS is not set
BR2_PACKAGE_LIBGCRYPT=y
BR2_PACKAGE_LIBEPOXY=y
BR2_PACKAGE_LIBWPE=y
BR2_PACKAGE_LIBSOUP3=y
BR2_PACKAGE_LIBTASN1=y
BR2_TARGET_ROOTFS_EXT2=y
BR2_TARGET_ROOTFS_EXT2_SIZE="512M"
# BR2_TARGET_ROOTFS_TAR is not set
BR2_TARGET_GRUB2=y
BR2_TARGET_GRUB2_I386_PC=y
BR2_TARGET_GRUB2_X86_64_EFI=y
BR2_TARGET_GRUB2_INSTALL_TOOLS=y
BR2_PACKAGE_HOST_DOSFSTOOLS=y
BR2_PACKAGE_HOST_GENIMAGE=y
BR2_PACKAGE_HOST_MTOOLS=y
BR2_PACKAGE_HOST_QEMU=y
BR2_PACKAGE_HOST_QEMU_SYSTEM_MODE=y
```

## package/kbd-toggle/Config.in
```kconfig
config BR2_PACKAGE_KBD_TOGGLE
	bool "kbd-toggle"
	depends on BR2_PACKAGE_WAYLAND
	select BR2_PACKAGE_CAIRO
	help
	  A tiny Wayland overlay button that toggles wvkbd visibility.
	  Draws a floating keyboard icon in the bottom-right corner of
	  the screen. On click/tap, sends SIGRTMIN to the wvkbd process.

	  https://github.com/doggyballs/RockOS (package/kbd-toggle/)
```

## package/rockos-browser/Config.in
```kconfig
config BR2_PACKAGE_ROCKOS_BROWSER
	bool "rockos-browser"
	depends on BR2_PACKAGE_QT5
	depends on BR2_PACKAGE_QT5WEBENGINE
	help
	  RockOS kiosk browser: a minimal QtWebEngine QWebEngineView
	  that loads the bundled EntropyLab app fullscreen.
```

## package/wvkbd/Config.in
```kconfig
config BR2_PACKAGE_WVKBD
	bool "wvkbd"
	depends on BR2_PACKAGE_WAYLAND
	select BR2_PACKAGE_LIBXKBCOMMON
	select BR2_PACKAGE_PANGO
	select BR2_PACKAGE_CAIRO
	help
	  On-screen virtual keyboard for Wayland compositors (wlroots-based).
	  Minimal C implementation with pango/cairo rendering.

	  Auto-show/hide on text input fields via zwp_input_method_v2
	  protocol (use --auto flag, requires compositor support), or
	  toggle via SIGRTMIN signal.

	  https://github.com/jjsullivan5196/wvkbd
```
